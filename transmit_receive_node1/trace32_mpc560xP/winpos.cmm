// T32 Wed Nov 05 10:29:00 2008

 B::
 
 TOOLBAR ON
 STATUSBAR ON
 WINPAGE.RESET
 
 WINCLEAR
 WINPOS 93.625 44.857 38. 7. 5. 0. W004
 Var.Frame
 
 WINPOS 129.75 44.786 24. 7. 0. 0. W005
 SPE
 
 WINPOS 115.63 40.214 42. 12. 0. 0. W004
 Var.Local
 
 WINPOS 94.375 0.0 60. 46. 0. 0. W007
 PER
 
 WINPOS 14.125 11.429 80. 25. 13. 1. W007
 WINTABS 10. 10. 25. 62.
 Data.List Fr_BuffersInit
 
 WINPOS 24.0 4.8571 74. 25. 0. 1. W006
 WINTABS 26. 26.
 sYmbol.Browse.Source \Main.c\*
 
 WINPOS 0.0 0.0 93. 45. 13. 1. W000
 WINTABS 10. 10. 25. 62.
 Data.List
 
 WINPOS 92.25 0.42857 66. 25. 13. 1. W006
 Data.dump (0x4000B000) /DIALOG
 
 WINPAGE.SELECT P000     
 
 ENDDO
